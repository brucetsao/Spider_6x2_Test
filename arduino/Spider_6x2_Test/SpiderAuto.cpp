/*
 *    Module: SpiderAuto.cpp
 *    Author: Jinn-Kwei Guo
 *    Date: 2016/6/10
 *      
 *    Auto Action for Spider
 *        
 */
 
#include "SpiderAuto.h"
#include "ServoPWM.h"
#include <avr/pgmspace.h>

SpiderAuto spiderAuto;


/* Spider leg action:
   array data : time(ms), angle1, angle2, angle3 ...... angle12
  direction of angle>90 : motor 0, 2, 4 : forward
                          motor 1, 3, 5 : in
                          motor 6, 8, 10 : backward
                          motot 7, 9, 11 : out
  angle limit: motor 0, 4, 6, 10 : 0~180/0
               motor 2, 8 : 45~135
               motor 1, 3, 5 : 0~135
               motor 7, 9 ,11: 45~180
*/
const PROGMEM uint16_t spiderAutoAction1[]  = { 
         500, 150,  90,    60,  90,    90,  90,   150,  90,    60,  90,    90,  90, //put leg set 2 
         100, 150,  90,    60,  85,    90,  90,   150,  95,    60,  90,    90,  95,
         100, 150,  90,    60,  80,    90,  90,   150, 100,    60,  90,    90, 100, 
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         100, 150,  80,    60,  90,    90,  80,   150,  90,    60, 100,    90,  90    
        //repeat put leg set 2         
    };
const PROGMEM uint16_t spiderAutoAction2[] = { 
         250,  30, 30, 30, 30, 30, 30, 30, 30, 30, 30, 30, 30, 
         250,  90, 90, 90, 90, 90, 90, 30, 30, 30, 30, 30, 30,
         250,  90, 90, 90, 90, 90, 90, 90, 90, 90, 90, 90, 90,
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         250,  90, 90, 90, 90, 90, 90, 30, 30, 30, 30, 30, 30 
    };
const PROGMEM uint16_t spiderAutoAction3[]= { 
         2000,   0,  0,  0,  0,  0,  0,  0,  0,  0,  0,  0,  0, 
         2000,  90, 90, 90, 90, 90, 90, 90, 90, 90, 90, 90, 90,
         2000, 180,180,180,180,180,180,180,180,180,180,180,180
    };


SpiderAuto::SpiderAuto() //constructor
{
    moveStep  = 0;
    actionType = 0; // no action
}

void SpiderAuto::beginAction(int actionType)
{ 
    this->actionType = actionType;
    moveStep  = 0;  
}


void SpiderAuto::nextMove()
{  
    int totalSteps=0;
    if (actionType==1) {
        totalSteps = sizeof(spiderAutoAction1)/sizeof(int)/13;
        pMoveTask->tickInterval = (unsigned long)pgm_read_word_near(spiderAutoAction1+moveStep*13)*1000L;
        for (int i=0; i<NumberOfServo; i++) {
            motor.setAngle(i,pgm_read_word_near(spiderAutoAction1+moveStep*13+(i+1)));
        }
        if (++moveStep>=totalSteps) moveStep=0;
    }
    if (actionType==2) {
        totalSteps = sizeof(spiderAutoAction2)/sizeof(int)/13;
        pMoveTask->tickInterval = (unsigned long)pgm_read_word_near(spiderAutoAction2+moveStep*13)*1000L;
        for (int i=0; i<NumberOfServo; i++) {
            motor.setAngle(i,pgm_read_word_near(spiderAutoAction2+moveStep*13+(i+1)));
        }
        if (++moveStep>=totalSteps) moveStep=0;
    } 
    if (actionType==3) {
       totalSteps = sizeof(spiderAutoAction3)/sizeof(int)/13;
        pMoveTask->tickInterval = (unsigned long)pgm_read_word_near(spiderAutoAction3+moveStep*13)*1000L;
        for (int i=0; i<NumberOfServo; i++) {
            motor.setAngle(i,pgm_read_word_near(spiderAutoAction3+moveStep*13+(i+1)));
        }
        if (++moveStep>=totalSteps) moveStep=0;
    }
}

